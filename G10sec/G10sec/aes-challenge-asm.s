#include <avr/io.h>

	.global gmul_asm
	.global ginv_asm
	.global inv_gen10sec_asm


alog_asm:
    .byte 0x01,0x1A,0x5F,0xF7,0xE5,0x6A,0x53,0x4F,0x4C,0x62,0x83,0x81,0xB5,0x0B,0xFE,0x2F
    .byte 0xFB,0x5D,0xC3,0x5B,0x9F,0x82,0x9B,0xEA,0xFC,0x1B,0x45,0xA8,0x12,0x8F,0x39,0x1C
    .byte 0x03,0x2E,0xE1,0x02,0x34,0xBE,0xF5,0xD1,0xD4,0xA6,0x9E,0x98,0xC4,0x1D,0x19,0x71
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    .byte 0xC2,0x41,0xC0,0x75,0x7E,0x80,0xAF,0x54,0x09,0xCA,0x91,0x0E,0x8C,0x17,0xFD,0x00

log_asm:
    .byte 0xFF,0xFF,0x23,0x20,0x46,0x40,0x43,0xD8,0x69,0xF8,0x63,0x0D,0x66,0xDD,0xFB,0x60
    .byte 0x8C,0x80,0x1C,0xC1,0x86,0xB1,0x30,0xFD,0x89,0x2E,0x01,0x19,0x1F,0x2D,0x83,0x38
    .byte 0xAF,0x58,0xA3,0xB6,0x3F,0x37,0xE4,0x4D,0xA9,0x9C,0xD4,0x4E,0x53,0x39,0x21,0x0F
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    .byte 0xEC,0x49,0xBD,0xDB,0xB8,0x26,0xDF,0x03,0xA1,0x6C,0x91,0x10,0x18,0xFE,0x0E,0xE0

// Saves non scratchable registers
.macro SAVE_REGISTERS
	 push r1
	 push r2
	 push r3
     push r4
     push r5
     push r6
     push r7
     push r8
     push r9
     push r10
     push r11
     push r12
     push r13
     push r14
     push r15
	 push r16
	 push r17
     .endm

// Reload non scratchable registers
.macro RESTORE_REGISTERS 
     pop        r17
     pop        r16
     pop        r15
     pop        r14
     pop        r13
     pop        r12
     pop        r11
     pop        r10
     pop        r9
     pop        r8
     pop        r7
     pop        r6
     pop        r5
     pop        r4
	 pop        r3
	 pop        r2
	 pop        r1
     .endm

// r24: a
// r22: b
gmul_asm:
	push	r15
	push	r16

	clr		r15
	inc		r15 // r15=1

	ldi		r30, lo8(log_asm)
	ldi		r31, hi8(log_asm)
	movw	r16, r30
	add		r30, r24
	adc		r31, r1
	elpm	r23, z // log[a]

	movw	r30, r16
	add		r30, r22
	adc		r31, r1
	elpm	r21, z // log[b]

	clr		r20
	add		r23, r21 // log[a]+log[b]
	adc		r20, r1

	add		r23, r20
	clr		r20
	add		r23, r15 // add 1
	adc		r20, r1 // get carry 
	eor		r20, r15 // xor 1
	sub		r23, r20 // modulo 255

	ldi		r30, lo8(alog_asm)
	ldi		r31, hi8(alog_asm)
	add		r30, r23
	adc		r31, r1
	elpm	r20, z // alog[log[a]+log[b] % 255]

    mul     r24, r22
    breq    gmul_zero_input
    clr     r1
    mov     r24, r20

    pop		r16
	pop		r15
	ret

gmul_zero_input:
    mov     r24, r1
    
	pop		r16
	pop		r15
	ret

	
// r24: a
ginv_asm:
	ldi		r30, lo8(log_asm)
	ldi		r31, hi8(log_asm)
	add		r30, r24
	adc		r31, r1
	elpm	r25, z // log[a]

	ldi		r23, 0x01
	ser		r22
	sub		r22, r25 // 255-log[a]
	clr		r25
	add		r22, r23 // add 1
	adc		r25, r1 //get carry
	eor		r25, r23 // carry XOR 1
	sub		r22, r25 // mod 255

	ldi		r30, lo8(alog_asm)
	ldi		r31, hi8(alog_asm)
	add		r30, r22
	adc		r31, r1
	elpm	r22, z // alog[255-log[a] % 255]

    tst     r24
    breq    ginv_zero_input
    mov     r24, r22
    ret
ginv_zero_input:
	ret

// r24: x
aff_trans_asm:
    //bit 0
    mov     r23, r24

    //bit 7
    lsl     r24
    clr     r22
    rol     r22
    eor     r24, r22
    eor     r23, r24

    //bit 6
    lsl     r24
    clr     r22
    rol     r22
    eor     r24, r22
    eor     r23, r24

    //bit 5
    lsl     r24
    clr     r22
    rol     r22
    eor     r24, r22
    eor     r23, r24
    
    //bit 4
    lsl     r24
    clr     r22
    rol     r22
    eor     r24, r22
    eor     r24, r23

    ret

// r24-25: round_key
inv_gen10sec_asm:
	SAVE_REGISTERS
	
	clr		r16
	movw	r14,r24
	

	clr		r7
	inc		r7 //r7=1
	ldi		r30,lo8(T)
	ldi		r31,hi8(T)
	movw	r10,r30

	ldi		r30,lo8(state)
	ldi		r31,hi8(state)
	movw	r12,r30

	ldi		r26,lo8(mask_state)
	ldi		r27,hi8(mask_state)

loop:
	movw	r30,r12
	add		r30,r16
	adc		r31,r1
	ld		r3,z //state[i]

	movw	r30,r14
	add		r30,r16
	adc		r31,r1
	ld		r2,z //key[i]
	eor		r2,r3 // state[i]^key[i]

	ldi		r30,lo8(mask_key)
	ldi		r31,hi8(mask_key)
	add		r30,r16
	adc		r31,r1
	ld		r3,z // mask_key[i]
	eor		r2,r3 // state[i]^key[i]^mask_key[i]

	
	add		r26,r16
	adc		r27,r1
	ld		r3,x // mask_state[i]

	movw	r30,r10
	add		r30,r3
	adc		r31,r1
	ld		r5,z
	eor		r5,r7
	st		z,r5 //T[mask_state[i]] ^= 1

	ldi		r30,lo8(mmul)
	ldi		r31,hi8(mmul)
	add		r30,r16
	adc		r31,r1
	ld		r5,z // mmul[i]

	// AMToMM
	lds		r6,r
	eor		r6,r2
	eor		r6,r3
	mov		r24,r6
	mov		r22,r5
	call	gmul_asm
	mov		r6,r24

	movw	r30,r10
	add		r30,r2
	adc		r31,r1
	ld		r4,z
	sts		mem,r4

	mov		r24,r4
	mov		r22,r5
	call	gmul_asm
	mov		r2,r24

	eor		r6,r2

	rjmp	nothing_to_see_here
preparing_for_launch:
	jmp		loop

nothing_to_see_here:
	// Inv
	mov		r24,r6
	call	ginv_asm
	mov		r6,r24

	// MMToAM
	ldi		r30,lo8(mout)
	ldi		r31,hi8(mout)
	add		r30,r16
	adc		r31,r1
	ld		r8,z // mout[i]

	mov		r2,r4
	eor		r2,r8
	lds		r9,r
	eor		r2,r9

	ldi		r30,lo8(mmul_inv)
	ldi		r31,hi8(mmul_inv)
	add		r30,r16
	adc		r31,r1
	ld		r22,z
	mov		r24,r2
	call	gmul_asm
	mov		r2,r24

	eor		r2,r6
	mov		r24,r2
	mov		r22,r5
	call	gmul_asm

	movw	r30,r10
	add		r30,r3
	adc		r31,r1
	ld		r5,z
	eor		r5,r7
	st		z,r5 //T[mask_state[i]] ^= 1

	call	aff_trans_asm
	ldi		r17,0x63
	eor		r17,r24

	movw	r30,r12
	add		r30,r16
	adc		r31,r1
	st		z,r17 

	mov		r24,r8
	call	aff_trans_asm

	st		x+,r24

	inc		r16
	cpi		r16,0x10
	brne	preparing_for_launch

	RESTORE_REGISTERS
	ret