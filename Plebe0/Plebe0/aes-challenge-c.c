#include "aes-challenge.h"
#include <avr/eeprom.h>

uint8_t _stored_key[16*11] = {0}; // all round keys

uint8_t mask_state[16];
uint8_t mask_key[16];
uint8_t mask_mC[16];


/* Sbox Lookup Table */
const uint8_t sbox[256] = {
    0x63, 0x7c, 0x77, 0x7b, 0xf2, 0x6b, 0x6f, 0xc5,
    0x30, 0x01, 0x67, 0x2b, 0xfe, 0xd7, 0xab, 0x76,
    0xca, 0x82, 0xc9, 0x7d, 0xfa, 0x59, 0x47, 0xf0,
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    0x41, 0x99, 0x2d, 0x0f, 0xb0, 0x54, 0xbb, 0x16
};

const uint8_t mCM2[] = {
	0x00,0x02,0x04,0x06,0x08,0x0a,0x0c,0x0e,0x10,0x12,0x14,0x16,0x18,0x1a,0x1c,0x1e,
	0x20,0x22,0x24,0x26,0x28,0x2a,0x2c,0x2e,0x30,0x32,0x34,0x36,0x38,0x3a,0x3c,0x3e,
	0x40,0x42,0x44,0x46,0x48,0x4a,0x4c,0x4e,0x50,0x52,0x54,0x56,0x58,0x5a,0x5c,0x5e,
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	0xfb,0xf9,0xff,0xfd,0xf3,0xf1,0xf7,0xf5,0xeb,0xe9,0xef,0xed,0xe3,0xe1,0xe7,0xe5};
	
const uint8_t mCM3[] = {
	0x00,0x03,0x06,0x05,0x0c,0x0f,0x0a,0x09,0x18,0x1b,0x1e,0x1d,0x14,0x17,0x12,0x11,
	0x30,0x33,0x36,0x35,0x3c,0x3f,0x3a,0x39,0x28,0x2b,0x2e,0x2d,0x24,0x27,0x22,0x21,
	0x60,0x63,0x66,0x65,0x6c,0x6f,0x6a,0x69,0x78,0x7b,0x7e,0x7d,0x74,0x77,0x72,0x71,
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	0x0b,0x08,0x0d,0x0e,0x07,0x04,0x01,0x02,0x13,0x10,0x15,0x16,0x1f,0x1c,0x19,0x1a
		};

const uint8_t rconst [] = {0x01, 0x02, 0x04, 0x08, 0x10, 0x20, 0x40, 0x80, 0x1b, 0x36, 0x6c};

void last_ark(uint8_t* state){
	uint8_t i;
	for(i=0; i < 16; i++){
		state[i] ^= _stored_key[16*10+i];
	}
}

void last_ark_rnd(uint8_t* state){
	uint8_t i;
	for(i=0; i < 16; i++){
		state[i] ^= _stored_key[16*10+i] ^ mask_key[i];
	}
}


/* shiftRows                Before         After
 * Row 1: No change        0 4  8 12      0  4  8 12    
 * Row 2: Left Shift by 1  1 5  9 13  =>  5  9 13  1    
 * Row 3: Left Shift by 2  2 6 10 14     10 14  2  6   
 * Row 4: Left Shift by 3  3 7 11 15     15 3   7 11  
 */
void shiftRows(uint8_t* state){
	uint8_t temp;
	//Row 1
	// no changes
	//Row 2
	temp = state[1]; state[1] = state[5]; state[5] = state[9];
    state[9] = state[13]; state[13] = temp;
	//Row 3
	temp = state[10]; state[10] = state[2]; state[2] = temp;
	temp = state[14]; state[14] = state[6]; state[6] = temp;
	//Row 4
	temp = state[3]; state[3] = state[15]; state[15] = state[11]; 
    state[11] = state[7]; state[7] = temp;
}

void mixColumns(uint8_t* state){
		
	uint8_t tmp[4];
	uint8_t i;
		
	for(i = 0; i<16; i+=4){
			
		tmp[0] = (mCM2[state[i]]) ^ (mCM3[state[1+i]]) ^ (state[2+i]) ^ (state[3+i]);
		tmp[1] = (state[i]) ^ (mCM2[state[1+i]]) ^ (mCM3[state[2+i]]) ^ (state[3+i]);
		tmp[2] = (state[i]) ^ (state[1+i]) ^ (mCM2[state[2+i]]) ^ (mCM3[state[3+i]]);
		tmp[3] = (mCM3[state[i]]) ^ (state[1+i]) ^ (state[2+i]) ^ (mCM2[state[3+i]]);
			
		state[i  ] = (int) tmp[0];
		state[i+1] = (int) tmp[1];
		state[i+2] = (int) tmp[2];
		state[i+3] = (int) tmp[3];
	}
		
}

// all round keys
void computeKey(uint8_t* key, uint8_t round){
	uint8_t rcon = rconst[round];
	uint8_t buf0, buf1, buf2, buf3;
	short unsigned idxp = round*16;
	short unsigned idx = idxp+16;
	buf0 = sbox[ key[idxp+13] ];
	buf1 = sbox[ key[idxp+14] ];
	buf2 = sbox[ key[idxp+15] ];
	buf3 = sbox[ key[idxp+12] ];
	
	key[idx+0] = key[idxp+0] ^ buf0 ^ rcon;
    key[idx+1] = key[idxp+1] ^ buf1;
    key[idx+2] = key[idxp+2] ^ buf2;
    key[idx+3] = key[idxp+3] ^ buf3;

	key[idx+4] = key[idxp+4] ^ key[idx+0];
	key[idx+5] = key[idxp+5] ^ key[idx+1];
	key[idx+6] = key[idxp+6] ^ key[idx+2];
	key[idx+7] = key[idxp+7] ^ key[idx+3];

	key[idx+8]  = key[idxp+8] ^ key[idx+4];
	key[idx+9]  = key[idxp+9] ^ key[idx+5];
	key[idx+10] = key[idxp+10] ^ key[idx+6];
	key[idx+11] = key[idxp+11] ^ key[idx+7];

	key[idx+12] = key[idxp+12] ^ key[idx+8];
	key[idx+13] = key[idxp+13] ^ key[idx+9];
	key[idx+14] = key[idxp+14] ^ key[idx+10];
	key[idx+15] = key[idxp+15] ^ key[idx+11];
	
}


void aes(uint8_t *in){
	int i;
	uint8_t state[16];
	
	// copy state
	for(i=0; i < 16; i++){
		state[i] = in[i];
	}

	ark_sb_asm(state, _stored_key, mask_state, mask_key);
	shiftRows(state);shiftRows(mask_mC);
	mixColumns(state);mixColumns(mask_mC);
	update_masks(state,mask_state,mask_mC);
	
	// AES Rounds
	for(i = 0; i < 8; i++){
        ark_sb_asm(state, _stored_key+(i+1)*16, mask_state, mask_key);
		shiftRows(state);shiftRows(mask_mC);
		mixColumns(state);mixColumns(mask_mC);
		update_masks(state,mask_state,mask_mC);
	}

	ark_sb_asm(state, _stored_key+(9)*16, mask_state, mask_key);
	shiftRows(state);shiftRows(mask_mC);
	update_masks(state,mask_state,mask_mC);
	last_ark_rnd(state);
	
	for(i=0; i < 16; i++){
		in[i] = state[i] ^ mask_state[i];
	}

	return;
}


void aes_indep_init(void){
	uint8_t seed;
	seed = eeprom_read_byte(0);
	srand(seed);
	eeprom_write_byte(0, seed);
	for (uint8_t i = 0; i < 16; i++){
		mask_key[i] = random() & 0xFF;
	}
}

void aes_indep_key(uint8_t * key){
	// init key here
    for (uint8_t i = 0; i < 16; i++){
        _stored_key[i] = key[i];
    }
    
    for(uint8_t i=0; i<10;i++){
    	computeKey(_stored_key, i);
    }
		// get random
	for (uint8_t i = 0; i < 16; i++){
		mask_state[i] = (random() & 0xFF) | 0x01;
		mask_mC[i] = mask_state[i];
	}

	// mask round key with mask_key
	for (uint32_t i = 0; i < 11; i++){
		for(uint32_t j = 0; j < 16; j++) {
			_stored_key[j+i*16] ^= mask_key[j];
		}
	}
}

void aes_indep_enc(uint8_t * pt){

	for(uint8_t i=0; i < 16; i++){
		pt[i] ^= mask_state[i];
	}
	aes(pt);
    
}

